## CMakeLists.txt
```
cmake_minimum_required(VERSION 3.20.0)

find_package(Zephyr REQUIRED)
project(my_zephyr_app)

target_sources(app PRIVATE 
	src/main.c
	src/sensor_shell.c
)
```

## Kconfig
```
mainmenu "LED Application"

menuconfig LED_SUBSYSTEM
    bool "LED Subsystem"
    default y

if LED_SUBSYSTEM

choice BLINK_SLEEP_TIME
    prompt "LED blink sleep time"
    default BLINK_SLEEP_1S

config BLINK_SLEEP_250MS
    bool "250ms"

config BLINK_SLEEP_500MS
    bool "500ms"

config BLINK_SLEEP_1S
    bool "1s (medium)"

config BLINK_SLEEP_2S
    bool "2s"

endchoice

config BLINK_SLEEP_TIME_MS
    int
    default 250 if BLINK_SLEEP_250MS
    default 500 if BLINK_SLEEP_500MS
    default 1000 if BLINK_SLEEP_1S
    default 2000 if BLINK_SLEEP_2S

menuconfig ADVANCED_LED_SETTINGS
    bool "Advanced LED settings"
    default n

if ADVANCED_LED_SETTINGS

config LED_BRIGHTNESS
    int "LED brightness (0-100)"
    range 0 100
    default 100

config LED_FADE_DURATION_MS
    int "LED fade duration (ms)"
    range 0 5000
    default 500

endif

menu "Expert settings"
    visible if ADVANCED_LED_SETTINGS

config LED_DEBUG
    bool "Enable LED debugging"
    default n

config CUSTOM_BLINK_PATTERN
    bool "Custom blink pattern"
    default n

endmenu
# New configuration for heartbeat assignment
config APP_HEARTBEAT_PERIOD_MS
        int "Heartbeat period (ms)"
        default 500
        range 100 2000

endif

# IMPORTANT:
# Load the complete Zephyr Kconfig tree.
source "Kconfig.zephyr" 
```

## prj.conf
```kconfig
CONFIG_GPIO=y
CONFIG_LOG=y
CONFIG_APP_HEARTBEAT_PERIOD_MS=1000
CONFIG_SENSOR=y
CONFIG_SERIAL=y
CONFIG_CONSOLE=y
CONFIG_UART_CONSOLE=y
CONFIG_PRINTK=y
CONFIG_SHELL=y
CONFIG_SHELL_CMD_BUFF_SIZE=128
CONFIG_SHELL_TAB=y
CONFIG_SHELL_TAB_AUTOCOMPLETION=y
CONFIG_SHELL_HISTORY=y
```

## app.overlay
```dts
/ {
	aliases {
	   app-led = &green_led_2;
	};
};
```

## src/main.c
```c
#include <zephyr/kernel.h>
#include <zephyr/sys/printk.h>

int main(void)
{
    printk("Board Initialized\n");

    return 0;
}
```

## src/sensor_shell.c
```c
#include <zephyr/kernel.h>
#include <zephyr/shell/shell.h>
#include <zephyr/device.h>
#include <zephyr/drivers/sensor.h>
#include <our_drivers/our_driver.h>
#include <stdlib.h>
#include <errno.h>

static const struct device *sensor_dev =
    DEVICE_DT_GET_ANY(our_driver);

/* sensor fetch */
static int cmd_sensor_fetch(const struct shell *sh,
                            size_t argc,
                            char **argv)
{
    ARG_UNUSED(argc);
    ARG_UNUSED(argv);

    if (!device_is_ready(sensor_dev)) {
        shell_error(sh, "Sensor device is not ready");
        return -ENODEV;
    }

    int ret = sensor_sample_fetch(sensor_dev);

    if (ret < 0) {
        shell_error(sh, "sensor_sample_fetch() failed: %d", ret);
        return ret;
    }

    shell_print(sh, "sensor_sample_fetch(): success");

    return 0;
}

/* sensor read */
static int cmd_sensor_read(const struct shell *sh,
                           size_t argc,
                           char **argv)
{
    ARG_UNUSED(argc);
    ARG_UNUSED(argv);

    if (!device_is_ready(sensor_dev)) {
        shell_error(sh, "Sensor device is not ready");
        return -ENODEV;
    }

    struct sensor_value value;

    int ret = sensor_channel_get(sensor_dev,
                                 SENSOR_CHAN_LIGHT,
                                 &value);

    if (ret < 0) {
        shell_error(sh, "sensor_channel_get() failed: %d", ret);
        return ret;
    }

    shell_print(sh, "Sensor value: %d", value.val1);

    return 0;
}

/* sensor info */
static int cmd_sensor_info(const struct shell *sh,
                           size_t argc,
                           char **argv)
{
    ARG_UNUSED(argc);
    ARG_UNUSED(argv);

    shell_print(sh,
                "Device: %s",
                sensor_dev->name);

    shell_print(sh,
                "Ready: %s",
                device_is_ready(sensor_dev) ? "yes" : "no");

    return 0;
}

static int cmd_sensor_set(const struct shell *sh,
                          size_t argc,
                          char **argv)
{
    ARG_UNUSED(argc);

    if (!device_is_ready(sensor_dev)) {
        shell_error(sh, "Sensor device is not ready");
        return -ENODEV;
    }

    char *endptr;
    long value = strtol(argv[1], &endptr, 10);

    if (*endptr != '\0') {
        shell_error(sh, "Invalid value: %s", argv[1]);
        return -EINVAL;
    }

    if (value < 0 || value > 100) {
        shell_error(sh, "Value must be between 0 and 100");
        return -ERANGE;
    }

    int ret = our_driver_set_custom_value(sensor_dev,
                                           (int)value);

    if (ret < 0) {
        shell_error(sh,
                    "Failed to set value: %d",
                    ret);
        return ret;
    }

    shell_print(sh,
                "Custom value set to %ld",
                value);

    return 0;
}

SHELL_STATIC_SUBCMD_SET_CREATE(
    sensor_cmds,

    SHELL_CMD(
        fetch,
        NULL,
        "Call sensor_sample_fetch()",
        cmd_sensor_fetch
    ),

    SHELL_CMD(
        read,
        NULL,
        "Call sensor_channel_get() and print the result",
        cmd_sensor_read
    ),

    SHELL_CMD(
        info,
        NULL,
        "Show sensor device information",
        cmd_sensor_info
    ),

    SHELL_CMD_ARG(
        set,
        NULL,
        "Set custom value: sensor set <value>",
        cmd_sensor_set,
        2,
        2
    ),

    SHELL_SUBCMD_SET_END
);

SHELL_CMD_REGISTER(
    sensor,
    &sensor_cmds,
    "Sensor commands",
    NULL
);
```
