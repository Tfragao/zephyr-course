## boards/our_board/board.yml
```yaml
board:
  name: our_board
  full_name: Nucleo F446RE
  vendor: st
  socs:
    - name: stm32f446xx
```

## boards/our_board_scratch/Kconfig.defconfig
```kconfig
# SPDX-License-Identifier: Apache-2.0

if BOARD_OUR_BOARD_SCRATCH

config BOARD
	default "our_board_scratch"

endif
```

## boards/our_board_scratch/Kconfig.our_board_scratch
```kconfig
# SPDX-License-Identifier: Apache-2.0

config BOARD_OUR_BOARD_SCRATCH
    select SOC_STM32F446XX
```

## boards/our_board_scratch/board.yml
```yaml
board:
  name: our_board_scratch
  full_name: Our Custom Nucleo F446RE Board
  vendor: st
  socs:
    - name: stm32f446xx
```

## modules/our-driver-module/drivers/our_driver/Kconfig
```kconfig
menuconfig OUR_DRIVER
    bool "Our Custom LED Sensor Driver"
    default y
    depends on SENSOR
    depends on DT_HAS_OUR_DRIVER_ENABLED
    select GPIO
    help
      Enable the custom LED sensor driver.
```

## modules/our-driver-module/dts/bindings/driver/our,driver.yaml
```yaml
description: Our custom LED sensor driver

compatible: "our,driver"

properties:
  led-gpios:
    type: phandle-array
    required: true
```

## our_board/Kconfig.our_board
```kconfig
# Copyright (c) 2018 Philémon Jaermann
# SPDX-License-Identifier: Apache-2.0

config BOARD_NUCLEO_F446RE_CUSTOM
	select SOC_STM32F446XX
```

## our_board/board.yml
```yaml
board:
  name: nucleo_f446re_custom
  full_name: Nucleo F446RE
  vendor: st
  socs:
    - name: stm32f446xx
```
